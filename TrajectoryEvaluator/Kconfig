## TrajectoryEvaluator/Kconfig
```kconfig
# Copyright (c) 2023, Arm Limited.
# SPDX-License-Identifier: Apache-2.0

config NET_IFACE1_ADDR
	string "Address for interface 1"
	default ""

config NET_IFACE1_GW
	string "Gateway for interface 1"
	default ""

config NET_IFACE1_NETMASK
	string "Netmask for interface 1"
	default ""

config NET_IFACE1_VLAN
	int "VLAN identifier for interface 1"
	default 0
	help
	  When different from 0, it sets the VLAN id for the interface 1.
	  Use 0 here if uncertain.

config NET_IFACE2_ADDR
	string "Address for interface 2"
	default ""

config NET_IFACE2_GW
	string "Gateway for interface 2"
	default ""

config NET_IFACE2_NETMASK
	string "Netmask for interface 2"
	default ""

config NET_IFACE2_VLAN
	int "VLAN identifier for interface 2"
	default 0
	help
	  When different from 0, it sets the VLAN id for the interface 2.
	  Use 0 here if uncertain.

# Override the range of MAX_PTHREAD_MUTEX_COUNT from zephyr/lib/posix/Kconfig
config MAX_PTHREAD_MUTEX_COUNT
	range 0 30000

config DDS_NETWORK_INTERFACE
	string "Name of the network interface to be used by CycloneDDS"
	help
	  When left undefined, CycloneDDS will automatically select an interface
	  based on its own criteria.

source "Kconfig.zephyr"
```

## TrajectoryEvaluator/boards/s32z270dc2_rtu0_r52_actuation.conf
```kconfig
# Copyright (c) 2023, Arm Limited.
# SPDX-License-Identifier: Apache-2.0

# Stack sizes
CONFIG_ETH_NXP_S32_RX_THREAD_STACK_SIZE=4096

# DHCP
CONFIG_NET_DHCPV4=y
CONFIG_NET_DHCPV4_INITIAL_DELAY_MAX=2

# SMP
CONFIG_SMP=n
```

## TrajectoryEvaluator/west.yml
```yaml
# Copyright (c) 2022-2024, Arm Limited.
# SPDX-License-Identifier: Apache-2.0

# The west manifest file for the actuation Zephyr app.
#
# The per-installation west configuration file, .west/config, sets the
# path to the project containing this file in the [manifest] section's
# "path" variable.

---
manifest:
  defaults:
    remote: upstream

  remotes:
    - name: upstream
      url-base: https://github.com/zephyrproject-rtos

  #
  # Please add items below based on alphabetical order
  projects:
    - name: cmsis
      revision: 5a00331455dd74e31e80efa383a489faea0590e3
      path: modules/hal/cmsis
      groups:
        - hal
    - name: hal_nxp
      revision: ad142f5612d927e29b1f9606e8edade871b8a526
      path: modules/hal/hal_nxp
      groups:
        - hal
    - name: zephyr
      revision: 339cd5a45fd2ebba064ef462b71c657336ca0dfe
      west-commands: scripts/west-commands.yml

  group-filter:
    - -ci

  self:
    path: zephyr_app
```
